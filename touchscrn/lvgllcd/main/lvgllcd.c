#include <stdio.h>
#include "freertos/FreeRTOS.h"
#include "freertos/task.h"
#include "esp_timer.h"
#include "esp_lcd_panel_io.h"
#include "esp_lcd_panel_vendor.h"
#include "esp_lcd_panel_ops.h"
#include "esp_lcd_ili9341.h"
#include "driver/gpio.h"
#include "driver/spi_master.h"
#include "esp_err.h"
#include "esp_log.h"
#include "lvgl.h"

static const char *TAG = "ILI9341_LVGL";

// ============ PIN CONFIGURATION ============
#define LCD_HOST       SPI2_HOST
#define LCD_PIXEL_CLOCK_HZ (40 * 1000 * 1000)
#define LCD_BK_LIGHT_ON_LEVEL  1
#define LCD_BK_LIGHT_OFF_LEVEL !LCD_BK_LIGHT_ON_LEVEL

#define PIN_NUM_MISO   6
#define PIN_NUM_MOSI   7
#define PIN_NUM_CLK    10
#define PIN_NUM_CS     2
#define PIN_NUM_DC     5
#define PIN_NUM_RST    4
#define PIN_NUM_BCKL   3

// ============ DISPLAY SETTINGS ============
#define LCD_H_RES      320
#define LCD_V_RES      240
#define LVGL_TICK_PERIOD_MS    2
#define LOGO_DISPLAY_TIME_MS   3000  // Show logo for 3 seconds

// ============ IMAGE DATA ============
#define IMG_WIDTH  100
#define IMG_HEIGHT 100

static const uint8_t my_image_map[] = {
    0x00, 0xF8,  // Red pixel (RGB565: 0xF800)
    0xE0, 0x07,  // Green pixel (RGB565: 0x07E0)  
    0x1F, 0x00,  // Blue pixel (RGB565: 0x001F)
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  0xff, 0xff, 0xff, 0xff, 0xff, 0xff, 0xff, 0xff, 0xff, 0xff, 0xff, 0xff,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 0xff, 
    // Include all your image data here
};

static const lv_image_dsc_t my_image = {
    .header.cf = LV_COLOR_FORMAT_RGB565,
    .header.w = IMG_WIDTH,
    .header.h = IMG_HEIGHT,
    .data_size = sizeof(my_image_map),
    .data = my_image_map,
};

// ============ LVGL DISPLAY ============
static esp_lcd_panel_handle_t panel_handle = NULL;
static lv_display_t *lvgl_display = NULL;
static lv_obj_t *logo_img = NULL;
static lv_obj_t *btn_container = NULL;
static bool showing_logo = true;
static uint32_t logo_start_time = 0;

static void lvgl_flush_cb(lv_display_t *display, const lv_area_t *area, uint8_t *px_map)
{
    int offsetx1 = area->x1;
    int offsetx2 = area->x2;
    int offsety1 = area->y1;
    int offsety2 = area->y2;
    
    esp_lcd_panel_draw_bitmap(panel_handle, offsetx1, offsety1, 
                             offsetx2 + 1, offsety2 + 1, px_map);
    
    lv_display_flush_ready(display);
}

static void increase_lvgl_tick(void *arg)
{
    lv_tick_inc(LVGL_TICK_PERIOD_MS);
}

// ============ BUTTON EVENT HANDLERS ============
static void button1_event_handler(lv_event_t *e)
{
    lv_event_code_t code = lv_event_get_code(e);
    if(code == LV_EVENT_CLICKED) {
        ESP_LOGI(TAG, "Button 1 clicked!");
        // Add your button 1 functionality here
    }
}

static void button2_event_handler(lv_event_t *e)
{
    lv_event_code_t code = lv_event_get_code(e);
    if(code == LV_EVENT_CLICKED) {
        ESP_LOGI(TAG, "Button 2 clicked!");
        // Add your button 2 functionality here
    }
}

static void button3_event_handler(lv_event_t *e)
{
    lv_event_code_t code = lv_event_get_code(e);
    if(code == LV_EVENT_CLICKED) {
        ESP_LOGI(TAG, "Button 3 clicked!");
        // Add your button 3 functionality here
    }
}

// ============ UI CREATION ============
static void create_ui(void)
{
    lv_obj_t *scr = lv_screen_active();
    
    // Set background color to black
    lv_obj_set_style_bg_color(scr, lv_color_hex(0x000000), 0);
    
    // Create logo image (centered, visible initially)
    logo_img = lv_image_create(scr);
    lv_image_set_src(logo_img, &my_image);
    lv_obj_center(logo_img);
    
    // Create container for buttons (centered, hidden initially)
    btn_container = lv_obj_create(scr);
    lv_obj_set_size(btn_container, LCD_H_RES - 20, 50);
    lv_obj_align(btn_container, LV_ALIGN_CENTER, 0, 0);
    lv_obj_set_flex_flow(btn_container, LV_FLEX_FLOW_ROW);
    lv_obj_set_flex_align(btn_container, LV_FLEX_ALIGN_SPACE_EVENLY, LV_FLEX_ALIGN_CENTER, LV_FLEX_ALIGN_CENTER);
    lv_obj_set_style_bg_color(btn_container, lv_color_hex(0x000000), 0);
    lv_obj_set_style_border_width(btn_container, 0, 0);
    lv_obj_set_style_pad_all(btn_container, 5, 0);
    lv_obj_add_flag(btn_container, LV_OBJ_FLAG_HIDDEN);  // Hide initially
    
    // Button 1
    lv_obj_t *btn1 = lv_button_create(btn_container);
    lv_obj_set_size(btn1, 90, 40);
    lv_obj_add_event_cb(btn1, button1_event_handler, LV_EVENT_CLICKED, NULL);
    lv_obj_set_style_bg_color(btn1, lv_color_hex(0x2196F3), 0);
    
    lv_obj_t *label1 = lv_label_create(btn1);
    lv_label_set_text(label1, "Button 1");
    lv_obj_center(label1);
    
    // Button 2
    lv_obj_t *btn2 = lv_button_create(btn_container);
    lv_obj_set_size(btn2, 90, 40);
    lv_obj_add_event_cb(btn2, button2_event_handler, LV_EVENT_CLICKED, NULL);
    lv_obj_set_style_bg_color(btn2, lv_color_hex(0x4CAF50), 0);
    
    lv_obj_t *label2 = lv_label_create(btn2);
    lv_label_set_text(label2, "Button 2");
    lv_obj_center(label2);
    
    // Button 3
    lv_obj_t *btn3 = lv_button_create(btn_container);
    lv_obj_set_size(btn3, 90, 40);
    lv_obj_add_event_cb(btn3, button3_event_handler, LV_EVENT_CLICKED, NULL);
    lv_obj_set_style_bg_color(btn3, lv_color_hex(0xFF9800), 0);
    
    lv_obj_t *label3 = lv_label_create(btn3);
    lv_label_set_text(label3, "Button 3");
    lv_obj_center(label3);
    
    ESP_LOGI(TAG, "UI created - showing logo initially");
    
    // Record start time
    logo_start_time = lv_tick_get();
}

// ============ MAIN APPLICATION ============
void app_main(void)
{
    ESP_LOGI(TAG, "Starting ILI9341 with LVGL v9");

    // Configure backlight GPIO
    if (PIN_NUM_BCKL >= 0) {
        gpio_config_t bk_gpio_config = {
            .mode = GPIO_MODE_OUTPUT,
            .pin_bit_mask = 1ULL << PIN_NUM_BCKL
        };
        ESP_ERROR_CHECK(gpio_config(&bk_gpio_config));
        gpio_set_level(PIN_NUM_BCKL, LCD_BK_LIGHT_ON_LEVEL);
    }

    // SPI bus configuration
    spi_bus_config_t buscfg = {
        .miso_io_num = PIN_NUM_MISO,
        .mosi_io_num = PIN_NUM_MOSI,
        .sclk_io_num = PIN_NUM_CLK,
        .quadwp_io_num = -1,
        .quadhd_io_num = -1,
        .max_transfer_sz = LCD_H_RES * 80 * sizeof(uint16_t),
    };
    ESP_ERROR_CHECK(spi_bus_initialize(LCD_HOST, &buscfg, SPI_DMA_CH_AUTO));

    // LCD panel IO configuration
    esp_lcd_panel_io_handle_t io_handle = NULL;
    esp_lcd_panel_io_spi_config_t io_config = {
        .dc_gpio_num = PIN_NUM_DC,
        .cs_gpio_num = PIN_NUM_CS,
        .pclk_hz = LCD_PIXEL_CLOCK_HZ,
        .lcd_cmd_bits = 8,
        .lcd_param_bits = 8,
        .spi_mode = 0,
        .trans_queue_depth = 10,
    };
    ESP_ERROR_CHECK(esp_lcd_new_panel_io_spi((esp_lcd_spi_bus_handle_t)LCD_HOST, 
                                             &io_config, &io_handle));

    // LCD panel configuration
    esp_lcd_panel_dev_config_t panel_config = {
        .reset_gpio_num = PIN_NUM_RST,
        .color_space = LCD_RGB_ELEMENT_ORDER_RGB,
        .bits_per_pixel = 16,
    };
    ESP_ERROR_CHECK(esp_lcd_new_panel_ili9341(io_handle, &panel_config, &panel_handle));
    ESP_ERROR_CHECK(esp_lcd_panel_reset(panel_handle));
    ESP_ERROR_CHECK(esp_lcd_panel_init(panel_handle));
    ESP_ERROR_CHECK(esp_lcd_panel_mirror(panel_handle, true, true));
    ESP_ERROR_CHECK(esp_lcd_panel_swap_xy(panel_handle, true));
    ESP_ERROR_CHECK(esp_lcd_panel_disp_on_off(panel_handle, true));

    ESP_LOGI(TAG, "LCD initialized");

    // Initialize LVGL
    lv_init();

    // Create LVGL display
    lvgl_display = lv_display_create(LCD_H_RES, LCD_V_RES);
    lv_display_set_flush_cb(lvgl_display, lvgl_flush_cb);

    // Allocate draw buffers
    size_t buffer_size = LCD_H_RES * 20 * sizeof(lv_color_t);  // Size in bytes
    lv_color_t *buf1 = heap_caps_malloc(buffer_size, MALLOC_CAP_DMA | MALLOC_CAP_INTERNAL);
    assert(buf1);
    lv_color_t *buf2 = heap_caps_malloc(buffer_size, MALLOC_CAP_DMA | MALLOC_CAP_INTERNAL);
    assert(buf2);
    lv_display_set_buffers(lvgl_display, buf1, buf2, buffer_size, LV_DISPLAY_RENDER_MODE_PARTIAL);

    ESP_LOGI(TAG, "LVGL initialized");

    // Create and start timer for LVGL tick
    const esp_timer_create_args_t lvgl_tick_timer_args = {
        .callback = &increase_lvgl_tick,
        .name = "lvgl_tick"
    };
    esp_timer_handle_t lvgl_tick_timer = NULL;
    ESP_ERROR_CHECK(esp_timer_create(&lvgl_tick_timer_args, &lvgl_tick_timer));
    ESP_ERROR_CHECK(esp_timer_start_periodic(lvgl_tick_timer, LVGL_TICK_PERIOD_MS * 1000));

    // Create UI
    create_ui();

    // Main loop
    while (1) {
        // Check if it's time to switch from logo to buttons
        if (showing_logo && (lv_tick_get() - logo_start_time) >= LOGO_DISPLAY_TIME_MS) {
            ESP_LOGI(TAG, "Hiding logo and showing buttons");
            lv_obj_del(logo_img);
            logo_img = NULL;
            lv_obj_clear_flag(btn_container, LV_OBJ_FLAG_HIDDEN);
            showing_logo = false;
        }
        
        uint32_t time_till_next = lv_timer_handler();
        vTaskDelay(pdMS_TO_TICKS(time_till_next > 0 ? time_till_next : 5));
    }
}